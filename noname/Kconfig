## noname/Kconfig
```kconfig
if VENDOR_noname
choice
	prompt "Mainboard model"

source "src/mainboard/noname/*/Kconfig.name"

endchoice

source "src/mainboard/noname/*/Kconfig"

config MAINBOARD_VENDOR
	default "H61M-S1"

endif # VENDOR_noname
```

## ongy/Kconfig
```kconfig
if VENDOR_ONGY

choice
	prompt "Mainboard model"

source "src/mainboard/ongy/*/Kconfig.name"

endchoice

source "src/mainboard/ongy/*/Kconfig"

config MAINBOARD_VENDOR
	default "Ongy"

endif # VENDOR_ONGY
```

## ongy/h61m-s1/Kconfig
```kconfig
## SPDX-License-Identifier: GPL-2.0-only

if BOARD_ONGY_H61M_S1

config BOARD_SPECIFIC_OPTIONS
	def_bool y
	select BOARD_ROMSIZE_KB_4096
	select HAVE_ACPI_RESUME
	select HAVE_ACPI_TABLES
	select INTEL_INT15
	select MAINBOARD_HAS_LIBGFXINIT
	select NORTHBRIDGE_INTEL_SANDYBRIDGE
	select SOUTHBRIDGE_INTEL_BD82X6X
	select USE_NATIVE_RAMINIT

config MAINBOARD_DIR
	string
	default ongy/h61m-s1

config MAINBOARD_PART_NUMBER
	string
	default "h61m-s1"

config MAX_CPUS
	int
	default 8

config USBDEBUG_HCD_INDEX
	int
	default 2
endif
```
